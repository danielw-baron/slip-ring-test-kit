// Author: Daniel Wilcox
// Purpose: Create a touchscreen interface for LCD to allow testing of Slip Ring signals
// Date Created: 06/29/23

// required libraries
#include "ILI9341_t3_Menu.h"          // custom utilities definition
#include "ILI9341_t3.h"                  // high speed display that ships with Teensy
#include <SPI.h>
#include "TouchScreen.h"
#include "font_Arial.h"                  // custom fonts that ships with ILI9341_t3.h
#include <font_ArialBold.h>

#define ROW_HEIGHT          35
#define ROWS                5
#define DATA_COLUMN         190

// pins for LED and select button on encoder
#define LED_PIN   7
#define CS_PIN    10
#define DC_PIN    9

// easy way to include fonts but change globally
#define FONT_SMALL  Arial_16            // font for menus
#define FONT_EDITTITLE  Arial_18_Bold            // font for menus
#define FONT_ITEM   Arial_16             // font for menus
#define FONT_TITLE  Arial_24_Bold        // font for all headings

#define DEBOUNCE    60

// These are the four touchscreen analog pins
#define YP A14  // must be an analog pin, use "An" notation!
#define XM A17  // must be an analog pin, use "An" notation!
#define YM 40   // can be a digital pin
#define XP 39   // can be a digital pin

// This is calibration data for the raw touch data to the screen coordinates
#define TS_MINX 120
#define TS_MINY 100
#define TS_MAXX 920
#define TS_MAXY 900

#define MINPRESSURE 10
#define MAXPRESSURE 1000

// Generic Declarations
bool programStarted = false;

// Digital Pin Setup
#define IN_DATA_1 14
#define IN_DATA_2 15
#define IN_DATA_3 16
#define IN_DATA_4 17
#define IN_DATA_5 18
#define IN_DATA_6 19
#define OUT_DATA_1 20
#define OUT_DATA_2 21
#define OUT_DATA_3 22
#define OUT_DATA_4 23
#define OUT_DATA_5 24
#define OUT_DATA_6 25
#define OUT_READ_1 26


int yPos = 40;
int signalCounter = 0;
int inVariationCounter = 0;
int outVariationCounter = 0;
int inLoopCounter = 0;
int outLoopCounter = 0;
bool inLoopBool = false;
bool outLoopBool = false;
int inSignalCounter = 0;
int outSignalCounter = 0;
int badSignalCounter = 0;
int goodSignalCounter = 0;
int signalInputID;

int IN_DATA_1_VAL;
int IN_DATA_2_VAL;
int IN_DATA_3_VAL;
int IN_DATA_4_VAL;
int IN_DATA_5_VAL;
int IN_DATA_6_VAL;

int OUT_DATA_1_VAL;
int OUT_DATA_2_VAL;
int OUT_DATA_3_VAL;
int OUT_DATA_4_VAL;
int OUT_DATA_5_VAL;
int OUT_DATA_6_VAL;

int inputValue;
int outputValue;
int inputSignalValue;
int outputSignalValue;

// Define a struct to store input and output values
struct SignalData 
{
  int inputSignalValue;
  int outputSignalValue;
};

// Define an array to store the data
SignalData signalData[100]; // Assuming a maximum of 100 entries

// Define a variable to keep track of the number of entries
int numEntries = 0;

// For better pressure precision, we need to know the resistance
// between X+ and X- Use any multimeter to read it
// For the one we're using, its 300 ohms across the X plate
TouchScreen ts = TouchScreen(XP, YP, XM, YM, 274);

int MenuOption = 0;
int AllowColorMenu = 1;

// global x y for touch stuff
int BtnX, BtnY;

int currentPressure;

// must have variables for each menu item
// best to have these global so you can use them in processing functions
int MenuOption1 = 0, MenuOption2 = 0, MenuOption3 = 0, MenuOption4 = 0, MenuOption5 = 0;
int MenuOption6 = 0, MenuOption7 = 0, MenuOption8 = 0, MenuOption9 = 0;

int OptionOption1 = 0, OptionOption2 = 0, OptionOption3 = 0, OptionOption4 = 0, OptionOption5 = 0;
int OptionOption6 = 0, OptionOption7 = 0, OptionOption8 = 0, OptionOption9 = 0;

int InfoOptions1 = 0, InfoOptions2 = 0, InfoOptions3 = 0, InfoOptions4 = 0, InfoOptions5 = 0;
int InfoOptions6 = 0, InfoOptions7 = 0, InfoOptions8 = 0, InfoOptions9 = 0, InfoOptions10 = 0, InfoOptions11 = 0;

int ResultsOptions1 = 0, ResultsOptions2 = 0, ResultsOptions3 = 0, ResultsOptions4 = 0, ResultsOptions5 = 0;
int ResultsOptions6 = 0, ResultsOptions7 = 0, ResultsOptions8 = 0, ResultsOptions9 = 0;
int ResultsOptions10 = 0, ResultsOptions11 = 0, ResultsOptions12 = 0, ResultsOptions13 = 0;

float Temp1Adj = 0.2, Temp2Adj = -.3, AlarmVal = 1;

long Position = 0, oldPosition = 0;

// create some selectable menu sub-items, these are lists inside a menu item
const char *ReadoutItems[] =   {"Absolute", "Deg F", "Deg C"
                               };
const char *RefreshItems[] =   {"Off", "1 second", "2 seconds", "10 seconds",
                                "30 seconds", "1 minute", "5 minutes"
                               };
const char *PrecisionItems[] =   {"10", "0", "0.0", "0.00", "0.000"
                                 };
const char *TuneItems[] =   {"Slope/Offset", "Simple", "Linear", "2nd order ", "3rd order", "Log"
                            };
const char *OffOnItems[] =   {"Off", "On"
                             };

const char *DataRateItems[] =   {"300 baud", "1.2 kbd", "2.4 kbd", "4.8 kbd", "9.6 kbd", "19.2 kbd", "56 kbd"
                                };


// OK i'm going crazy with examples, but this will help show more processing when an int is needed but a float returned
// from the menu code
const char *SIGNAL_NAMES[] = {"Signal 1", "Signal 2", "Signal 3", "Signal 4", "Signal 5", "Signal 6", "Signal 7", 
                              "Signal 8", "Signal 9", "Signal 10", "Signal 11", "Signal 12", "Signal 13", "Signal 14", 
                              "Signal 15", "Signal 16", "Signal 17", "Signal 18", "Signal 19", "Signal 20", "Signal 21", 
                              "Signal 22", "Signal 23", "Signal 24", "Signal 25", "Signal 26", "Signal 27", "Signal 28", 
                              "Signal 29", "Signal 30", "Signal 31", "Signal 32", "Signal 33", "Signal 34", "Signal 35", 
                              "Signal 36", "Signal 37"
                            };

const uint16_t  C_VALUES[] = {  0XFFFF, 0X0000, 0XC618, 0X001F, 0XF800, 0X07E0, 0X07FF, 0XF81F, //7
                                0XFFE0, 0X0438, 0XFD20, 0XF81F, 0X801F, 0XE71C, 0X73DF, 0XFBAE, //15
                                0X7FEE, 0X77BF, 0XFBB7, 0XF7EE, 0X77FE, 0XFDEE, 0XFBBA, 0XD3BF, //23
                                0X7BCF, 0X1016, 0XB000, 0X0584, 0X04B6, 0XB010, 0XAD80, 0X0594, //31
                                0XB340, 0XB00E, 0X8816, 0X4A49, 0X0812, 0X9000, 0X04A3, 0X0372, //39
                                0X900B, 0X94A0, 0X0452, 0X92E0, 0X9009, 0X8012 //45
                             };
// set default colors
uint16_t MENU_TEXT = C_VALUES[1];
uint16_t MENU_BACKGROUND = C_VALUES[0];
uint16_t MENU_HIGHLIGHTTEXT = C_VALUES[1];
uint16_t MENU_HIGHLIGHT = C_VALUES[21];
uint16_t MENU_HIGHBORDER = C_VALUES[10];
uint16_t MENU_SELECTTEXT = C_VALUES[0];
uint16_t MENU_SELECT = C_VALUES[4];
uint16_t MENU_SELECTBORDER = C_VALUES[37];
uint16_t MENU_DISABLE = C_VALUES[2];
uint16_t TITLE_TEXT = C_VALUES[13];
uint16_t TITLE_BACK = C_VALUES[36];

// this next rediciously long section is merely the icon image data
// scroll down to 1540 or so for the actual code

// Website for generating icons
// https://javl.github.io/image2cpp/

// all icons created at that site and copy / pasted here
// 'baronlogo', 64x64px
const uint16_t epd_bitmap_baron [] PROGMEM = {
  0xd968, 0xd927, 0xd927, 0xd927, 0xd927, 0xd927, 0xd927, 0xd927, 0xd927, 0xd927, 0xd927, 0xd927, 0xd927, 0xd927, 0xd927, 0xd927, 
  0xd927, 0xd927, 0xd927, 0xd927, 0xd927, 0xd927, 0xd927, 0xd927, 0xd927, 0xd927, 0xd927, 0xd927, 0xd927, 0xd927, 0xd927, 0xd927, 
  0xd927, 0xd927, 0xd927, 0xd927, 0xd927, 0xd927, 0xd927, 0xd927, 0xd927, 0xd927, 0xd927, 0xd927, 0xd927, 0xd927, 0xd927, 0xd927, 
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  0xd8e6, 0xd8e6, 0xd8e6, 0xd8e6, 0xd8e6, 0xd8e6, 0xd8e6, 0xd8e6, 0xd8e6, 0xd8e6, 0xd8e6, 0xd8e6, 0xd8e6, 0xd8e6, 0xd8e6, 0xd8e6
};
// 'moreinfoicon', 64x64px
const uint16_t epd_bitmap_info [] PROGMEM = {
  0xef7d, 0xffff, 0xffff, 0xef7d, 0xffff, 0xef7d, 0xffff, 0xffff, 0xef7d, 0xffff, 0xef7d, 0xef7d, 0xffff, 0xef7d, 0xffff, 0xef7d, 
  0xef7d, 0xffff, 0xef7d, 0xffff, 0xef7d, 0xef7d, 0xffff, 0xef7d, 0xffff, 0xffff, 0xef7d, 0xffff, 0xef7d, 0xffff, 0xffff, 0xef7d, 
  0xffff, 0xef7d, 0xef5d, 0xffff, 0xef7d, 0xffff, 0xef7d, 0xef7d, 0xffff, 0xef7d, 0xffff, 0xffff, 0xef7d, 0xffff, 0xef7d, 0xffff, 
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  0xef7d, 0xffff, 0xef7d, 0xffff, 0xef7d, 0xef7d, 0xffff, 0xef7d, 0xffff, 0xffff, 0xef7d, 0xffff, 0xef7d, 0xffff, 0xffff, 0xef7d
};

// 'resultsIcon', 64x64px
const uint16_t epd_bitmap_results [] PROGMEM = {
	0xffff, 0xffff, 0xffff, 0xffff, 0xffff, 0xffff, 0xffff, 0xffff, 0xffff, 0xffff, 0xffff, 0xffff, 0xffff, 0xffff, 0xffff, 0xffff, 
	0xffff, 0xffff, 0xffff, 0xffff, 0xffff, 0xffff, 0xffff, 0xffff, 0xffff, 0xffff, 0xffff, 0xffff, 0xffff, 0xffff, 0xffff, 0xffff, 
	0xffff, 0xffff, 0xffff, 0xffff, 0xffff, 0xffff, 0xffff, 0xffff, 0xffff, 0xffff, 0xffff, 0xffff, 0xffff, 0xffff, 0xffff, 0xffff, 
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	0xffff, 0xffff, 0xffff, 0xffff, 0xffff, 0xffff, 0xffff, 0xffff, 0xffff, 0xffff, 0xffff, 0xffff, 0xffff, 0xffff, 0xffff, 0xffff
};

ILI9341_t3 Display(CS_PIN, DC_PIN); 
ItemMenu MainMenu(&Display);

EditMenu OptionMenu(&Display);
EditMenu InfoMenu(&Display);
EditMenu ResultsMenu(&Display);

TSPoint TouchPoint = ts.getPoint();

void setup() 
{
  analogWriteResolution(12);
  pinSetup();
  pinMode(LED_PIN, OUTPUT);
  delay(300);
  digitalWrite(LED_PIN, HIGH);
  Display.begin();
  analogWrite(7, 2047); // 2047 is halfway between 0 and 4095
  Display.setRotation(3);
  Display.fillScreen(0);

  MainMenu.init(MENU_TEXT, MENU_BACKGROUND, MENU_HIGHLIGHTTEXT, MENU_HIGHLIGHT, 64, 3, "Slip Ring Test", FONT_TITLE, FONT_TITLE);

  MenuOption1 = MainMenu.add565("Run", epd_bitmap_baron, 64, 64);
  MenuOption2 = MainMenu.add565("Info", epd_bitmap_info, 64, 64);
  MenuOption3 = MainMenu.add565("Results", epd_bitmap_results, 64, 64);

  MainMenu.setTitleColors(TITLE_TEXT, TITLE_BACK);
  MainMenu.setTitleBarSize(0, 0, 320, 40);
  MainMenu.setTitleTextMargins(60, 7);
  MainMenu.setIconMargins(0, 0);
  MainMenu.setMenuBarMargins(0, 310, 10, 4);
  MainMenu.setItemColors(MENU_DISABLE, MENU_SELECTBORDER);
  MainMenu.setItemTextMargins(10, 15, 5);

  OptionMenu.init(MENU_TEXT, MENU_BACKGROUND, MENU_HIGHLIGHTTEXT, MENU_HIGHLIGHT, MENU_SELECTTEXT, MENU_SELECT,
                  DATA_COLUMN, ROW_HEIGHT, ROWS, "Options", FONT_ITEM, FONT_TITLE);

  OptionMenu.setTitleColors(TITLE_TEXT, TITLE_BACK);
  OptionMenu.setTitleBarSize(0, 0, 320, 40);
  OptionMenu.setTitleTextMargins(60, 7);
  OptionMenu.setIconMargins(5, 0);
  OptionMenu.setItemTextMargins(7, 9, 10);
  OptionMenu.setItemColors(MENU_DISABLE, MENU_HIGHBORDER, MENU_SELECTBORDER);

  InfoMenu.init(MENU_TEXT, MENU_BACKGROUND, MENU_HIGHLIGHTTEXT, MENU_HIGHLIGHT, MENU_SELECTTEXT, MENU_SELECT,
                    DATA_COLUMN, ROW_HEIGHT, ROWS, "Information", FONT_ITEM, FONT_TITLE);
  InfoMenu.setTitleColors(TITLE_TEXT, TITLE_BACK);
  InfoMenu.setTitleBarSize(0, 0, 320, 40);
  InfoMenu.setTitleTextMargins(60, 7);
  InfoMenu.setIconMargins(5, 0);
  InfoMenu.setItemTextMargins(7, 9, 10);
  InfoMenu.setItemColors(MENU_DISABLE, MENU_HIGHBORDER, MENU_SELECTBORDER);

  ResultsMenu.init(MENU_TEXT, MENU_BACKGROUND, MENU_HIGHLIGHTTEXT, MENU_HIGHLIGHT, MENU_SELECTTEXT, MENU_SELECT,
                    DATA_COLUMN, ROW_HEIGHT, ROWS, "Results", FONT_ITEM, FONT_TITLE);
  ResultsOptions1 = ResultsMenu.addNI("Input:", 0, 0, 37, 1, 0, SIGNAL_NAMES);
  ResultsMenu.setTitleColors(TITLE_TEXT, TITLE_BACK);
  ResultsMenu.setTitleBarSize(0, 0, 320, 40);
  ResultsMenu.setTitleTextMargins(60, 7);
  ResultsMenu.setIconMargins(5, 0);
  ResultsMenu.setItemTextMargins(7, 9, 10);
  ResultsMenu.setItemColors(MENU_DISABLE, MENU_HIGHBORDER, MENU_SELECTBORDER);


  ProcessMainMenu();
  Display.fillScreen(MENU_BACKGROUND);

}

void loop() 
{ 
  ProcessMainMenu();
  Display.fillScreen(MENU_BACKGROUND);
}

int ProcessMainMenu() 
{
  int MainMenuOption = 1;
  Display.fillScreen(MENU_BACKGROUND);
  MainMenu.draw();


  while (MainMenuOption != 0) {
    delay(50);
    TouchPoint = ts.getPoint();
    currentPressure = TouchPoint.z;
    if (MINPRESSURE < currentPressure && currentPressure < MAXPRESSURE) 
    {
      ProcessTouch();
      MainMenuOption = ProcessButtonPress(MainMenu);

      if (MainMenuOption == MenuOption1) 
      {
        ProcessOptionMenu();
        Display.fillScreen(MENU_BACKGROUND);
        MainMenu.draw();
      }
      if (MainMenuOption == MenuOption2) 
      {
        ProcessInfoMenu();
        Display.fillScreen(MENU_BACKGROUND);
        MainMenu.draw();
      }
      if (MainMenuOption == MenuOption3) 
      {
      ProcessResultsMenu();
      Display.fillScreen(MENU_BACKGROUND);
      MainMenu.draw();
      }
    }
  }
  return MainMenuOption;
}

void ProcessOptionMenu() 
{
  int EditMenuOption = 1;
  Display.fillScreen(MENU_BACKGROUND);
  OptionMenu.draw();
 
  inLoopBool = false;
  inLoopCounter = 0;
  inVariationCounter = 0;
  outLoopBool = false;
  outLoopCounter = 0;
  outVariationCounter = 0;
  signalCounter = 0;
  yPos = 40;
  memset(signalData, 0, sizeof(signalData));

  while (EditMenuOption != 0) 
  {
    sendSignal();
    inLoopBool = true;
    TouchPoint = ts.getPoint();
    currentPressure = TouchPoint.z;
    if (MINPRESSURE < currentPressure && currentPressure < MAXPRESSURE) 
    {
      delay(50);
      ProcessTouch();
      EditMenuOption = ProcessButtonPress(OptionMenu);
    }
  }
}

void ProcessInfoMenu() 
{
  int InfoMenuOption = 1;
  Display.fillScreen(MENU_BACKGROUND);
  InfoMenu.draw();
  while (InfoMenuOption != 0) 
  {
    displayInfo();
    TouchPoint = ts.getPoint();
    currentPressure = TouchPoint.z;
    if (MINPRESSURE < currentPressure && currentPressure < MAXPRESSURE) 
    {
      ProcessTouch(); 
      InfoMenuOption = InfoMenu.press(BtnX, BtnY);
      InfoMenu.drawRow(InfoMenuOption);
    }
  }
}

void ProcessResultsMenu() 
{
  int ResultsMenuOption = 1;
  Display.fillScreen(MENU_BACKGROUND);
  ResultsMenu.draw();
  Display.setCursor(0, 100);  // Set the starting position of the text
  Display.setTextSize(2);
  Display.print("    Output:");
  inputValue = ResultsMenu.value[ResultsOptions1] + 1;
  outputValue = getOutputForInput(inputValue);
  Display.setCursor(190, 100);  // Set the starting position of the text
  Display.print("Signal ");
  Display.print(outputValue);

  while (ResultsMenuOption != 0) 
  {
    TouchPoint = ts.getPoint();
    currentPressure = TouchPoint.z;
    if (MINPRESSURE < currentPressure && currentPressure < MAXPRESSURE) 
    {
      ProcessTouch(); 
      ResultsMenuOption = ResultsMenu.press(BtnX, BtnY);
      ResultsMenu.drawRow(ResultsMenuOption);
      Display.fillRect(190, 100, 100, 200, ILI9341_WHITE);
      inputValue = ResultsMenu.value[ResultsOptions1] + 1;
      outputValue = getOutputForInput(inputValue);
      Display.setCursor(190, 100);  // Set the starting position of the text
      if (outputValue == -1)
      {
        Display.print("No output");
      }
      else
      {
        Display.print("Signal ");
        Display.print(outputValue);
      }

    }
  }
}


void ProcessTouch() 
{
  int temp1;
  BtnX = map(TouchPoint.x, TS_MINX, TS_MAXX, 0, 240);
  BtnY = map(TouchPoint.y, TS_MINY, TS_MAXY, 0, 320);
  temp1 = BtnX;
  BtnX = 320 - BtnY;
  BtnY = temp1;
}

int ProcessButtonPress(ItemMenu &TheMenu) 
{
  int TheItem = 0, NewItem = 0;
  TheItem = TheMenu.press(BtnX, BtnY);
  TheMenu.drawRow(TheItem, BUTTON_PRESSED);
  TouchPoint = ts.getPoint();
  currentPressure = TouchPoint.z;
  if (MINPRESSURE < currentPressure && currentPressure < MAXPRESSURE) {
    ProcessTouch();
    NewItem = TheMenu.press(BtnX, BtnY);
    if (TheItem != NewItem) {
      TheMenu.drawRow(TheItem, BUTTON_NOTPRESSED);
      return -1;
    }
  }
  if (TheItem == NewItem) {
    TheMenu.drawRow(TheItem, BUTTON_NOTPRESSED);
    return TheItem;
  }
  return -1;
}

int ProcessButtonPress(EditMenu &TheMenu) 
{
  int TheItem = 0, NewItem = 0;
  TheItem = TheMenu.press(BtnX, BtnY);
  if (TheItem == -1) {
    return -1;
  }

  TheMenu.drawRow(TheItem);
  TouchPoint = ts.getPoint();
  currentPressure = TouchPoint.z;
  if (MINPRESSURE < currentPressure && currentPressure < MAXPRESSURE) {
    ProcessTouch();
    NewItem = TheMenu.press(BtnX, BtnY);
    if (TheItem != NewItem) {

      TheMenu.drawRow(TheItem);

      return NewItem;
    }
  }
  if (TheItem == NewItem) {

    TheMenu.drawRow(TheItem);

    return TheItem;
  }
  delay(50);
  return TheItem;
}

void pinSetup() // Setup each digital pin 
{
  pinMode(IN_DATA_1, OUTPUT);
  pinMode(IN_DATA_2, OUTPUT);
  pinMode(IN_DATA_3, OUTPUT);
  pinMode(IN_DATA_4, OUTPUT);
  pinMode(IN_DATA_5, OUTPUT);
  pinMode(IN_DATA_6, OUTPUT);
  pinMode(OUT_DATA_1, OUTPUT);
  pinMode(OUT_DATA_2, OUTPUT);
  pinMode(OUT_DATA_3, OUTPUT);
  pinMode(OUT_DATA_4, OUTPUT);
  pinMode(OUT_DATA_5, OUTPUT);
  pinMode(OUT_DATA_6, OUTPUT);
  pinMode(OUT_READ_1, INPUT);
  digitalWrite(IN_DATA_1, HIGH); 
  digitalWrite(IN_DATA_2, HIGH); 
  delay(1000);
}

void sendSignal()
{
  while(inLoopBool == false)
  {
    if(inLoopCounter == 3)
    {
      digitalWrite(IN_DATA_1, HIGH); 
      digitalWrite(IN_DATA_2, HIGH); 
      outLoopBool = true;
      inLoopBool = true;
    }

    if (inLoopCounter == 0)
    {
      digitalWrite(IN_DATA_1, LOW);  
      digitalWrite(IN_DATA_2, LOW);
      IN_DATA_1_VAL = 0;
      IN_DATA_2_VAL = 0;
    }
    else if (inLoopCounter == 1)
    {
      digitalWrite(IN_DATA_1, HIGH);  
      digitalWrite(IN_DATA_2, LOW);
      IN_DATA_1_VAL = 1;
      IN_DATA_2_VAL = 0;
    }
    else if (inLoopCounter == 2)
    {
      digitalWrite(IN_DATA_1, LOW);  
      digitalWrite(IN_DATA_2, HIGH);
      IN_DATA_1_VAL = 0;
      IN_DATA_2_VAL = 1;
    }

    IN_DATA_6_VAL = (inVariationCounter >> 3) & 1;
    IN_DATA_5_VAL = (inVariationCounter >> 2) & 1;
    IN_DATA_4_VAL = (inVariationCounter >> 1) & 1;
    IN_DATA_3_VAL = inVariationCounter & 1;


    if (inVariationCounter == 15)
    {
      inVariationCounter = -1;
      inLoopCounter++;
    }
    if (inVariationCounter == 4 && inLoopCounter == 2)
    {
      inVariationCounter = -1;
      inLoopCounter++;
    }
    inVariationCounter++;
    
    digitalWrite(IN_DATA_3, IN_DATA_3_VAL); 
    digitalWrite(IN_DATA_4, IN_DATA_4_VAL);  
    digitalWrite(IN_DATA_5, IN_DATA_5_VAL);  
    digitalWrite(IN_DATA_6, IN_DATA_6_VAL); 

    signalCounter++;

    while(outLoopBool == false)
    {
      if (outLoopCounter == 0)
      {
        digitalWrite(OUT_DATA_1, LOW);  
        digitalWrite(OUT_DATA_2, LOW);
        OUT_DATA_1_VAL = 0;
        OUT_DATA_2_VAL = 0;
      }
      else if (outLoopCounter == 1)
      {
        digitalWrite(OUT_DATA_1, HIGH);  
        digitalWrite(OUT_DATA_2, LOW);
        OUT_DATA_1_VAL = 1;
        OUT_DATA_2_VAL = 0;
      }
      else if (outLoopCounter == 2)
      {
        digitalWrite(OUT_DATA_1, LOW);  
        digitalWrite(OUT_DATA_2, HIGH);
        OUT_DATA_1_VAL = 0;
        OUT_DATA_2_VAL = 1;
      }

      OUT_DATA_6_VAL = (outVariationCounter >> 3) & 1;
      OUT_DATA_5_VAL = (outVariationCounter >> 2) & 1;
      OUT_DATA_4_VAL = (outVariationCounter >> 1) & 1;
      OUT_DATA_3_VAL = outVariationCounter & 1;

      digitalWrite(OUT_DATA_3, OUT_DATA_3_VAL);
      digitalWrite(OUT_DATA_4, OUT_DATA_4_VAL);
      digitalWrite(OUT_DATA_5, OUT_DATA_5_VAL);
      digitalWrite(OUT_DATA_6, OUT_DATA_6_VAL);

      readSignal();
  
      if(outVariationCounter == 15)
      {
        outVariationCounter = -1;
        outLoopCounter++;
      }
      if (outVariationCounter == 4 && outLoopCounter == 2)
      {
        outVariationCounter = -1;
        outLoopCounter++;
      }
      outVariationCounter++;
      if(outLoopCounter == 3)
      {
        outVariationCounter = 0;
        outLoopCounter = 0;
        break;
      } 
    }
  }
}

void readSignal()
{
  bool status;
  delay(10);
  if((digitalRead(OUT_READ_1)))
  {
    status = 1;
  }
  if(!(digitalRead(OUT_READ_1)))
  {
    status = 0;
  }
  printLCD(status);
}

void printLCD(bool status)
{
  Display.setTextColor(ILI9341_BLACK);  // Set text color
  Display.setTextSize(3);
  Display.setCursor(0, yPos);  // Set the starting position of the text

  if(yPos >= 240)
  {
    delay(500);   // Delay to see end of screen results
    Display.fillRect(0, 40, 320, 200, ILI9341_WHITE);
    yPos = 40;
  }
  String inputID = String(IN_DATA_1_VAL) + String(IN_DATA_2_VAL) + String(IN_DATA_3_VAL) +
            String(IN_DATA_4_VAL) + String(IN_DATA_5_VAL) + String(IN_DATA_6_VAL);
  String outputID = String(OUT_DATA_1_VAL) + String(OUT_DATA_2_VAL) + String(OUT_DATA_3_VAL) +
            String(OUT_DATA_4_VAL) + String(OUT_DATA_5_VAL) + String(OUT_DATA_6_VAL);
  if(status == 1)
  {
    if(inputID == outputID)
    {
      Display.print("Success for Signal #");
      Display.println(signalCounter);
    }
    else{
      Display.print("    * Mismatch for Signal #");
      Display.println(signalCounter);
    }

    inputSignalValue = (IN_DATA_6_VAL * 8) + (IN_DATA_5_VAL * 4) + (IN_DATA_4_VAL * 2) + (IN_DATA_3_VAL * 1) + ((IN_DATA_2_VAL * 2) + (IN_DATA_1_VAL * 1))*16 + 1;
    outputSignalValue = (OUT_DATA_6_VAL * 8) + (OUT_DATA_5_VAL * 4) + (OUT_DATA_4_VAL * 2) + (OUT_DATA_3_VAL * 1) + ((OUT_DATA_2_VAL * 2) + (OUT_DATA_1_VAL * 1))*16 + 1;

    storeSignalData(inputSignalValue, outputSignalValue);

    yPos = yPos + 20;
  }
  else
  {
    if(inputID == outputID)
    {
      Display.print("Missing Signal #");
      Display.println(signalCounter);
      yPos = yPos + 20;
    }
  }
}

// Function to store the data
void storeSignalData(int input, int output) 
{
  if (numEntries < 100) { // Ensure we don't exceed the array size
    signalData[numEntries].inputSignalValue = input;
    signalData[numEntries].outputSignalValue = output;
    numEntries++;
  } 
  else 
  {
    // Handle error: Data storage is full
  }
}

// Function to retrieve outputSignalValue for a given inputSignalValue
int getOutputForInput(int input) 
{
  for (int i = 0; i < numEntries; i++) 
  {
    if (signalData[i].inputSignalValue == input) 
    {
      return signalData[i].outputSignalValue;
    }
  }
  // Handle error: Input not found
  return -1; // Default value for error
}

void displayInfo()
{
  Display.setTextColor(ILI9341_BLACK);
  Display.setTextSize(1);
  Display.setCursor(0, 40);  // Set the starting position of the text
  Display.print("This Slip Ring Test Kit will send a test signal of 15V 0.5A through each input and identifies which output channel recieved the signal.  For more info please visit https://github.com/danielw-baron/slip-ring-test-kit");  // Print the text
}
